## boards/shields/Test/Kconfig.defconfig
```kconfig
if SHIELD_TEST

# Name must be less than 16 characters long!
config ZMK_KEYBOARD_NAME
    default "Test"

endif
```

## config/west.yml
```yaml
manifest:
  remotes:
    - name: zmkfirmware
      url-base: https://github.com/zmkfirmware
    - name: zmk-config-test
      url-base: https://github.com/DeppressedCabbage
    # Additional modules containing boards/shields/custom code can be listed here as well
    # See https://docs.zephyrproject.org/3.2.0/develop/west/manifest.html#projects
  projects:
    - name: zmk
      remote: zmkfirmware
      revision: main
      import: app/west.yml
      name: zmk-config-test
      remote: zmk-config-test
      revision: master
      import: boards/shields/Test
  self:
    path: config
```
